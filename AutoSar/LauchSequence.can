/*@!Encoding:1252*/
includes
{
  
}

variables
{
  message LaunchControl lc;
  message BrakeMsg br;
  message SpeedMsg sp;
  message ThrottleMsg tr;
  message BoostPressure bp;
  msTimer timer_sp;
  
  
}
on start
{ sp.Speed=0;
  tr.ThrottlePosition=0;
  //lc.LaunchStatus=0;
  br.Brake_Status=0;
  output(sp);
  output(lc);
  
  
  //output(tr);

  setTimer(timer_sp,100);
  
}
on timer timer_sp
{ 
  //output(tr);
  setTimer(timer_sp,100);
  output(sp);
  output(lc);
  
  
  
}

on message LaunchControl
{write("Entering");
  setTimer(timer_sp,100);
  output(sp);
  if(br.Brake_Status==1)
{
 if((lc.ActiveSwitch==1)&&(lc.LauchSwitch==1))
  { lc.LaunchStatus=1;
    output(lc);
  output(br);
  }
  write("Launch Sequence Active");
  if(tr.ThrottlePosition==0)
  {
    write("Awaiting Full Throttle");
  }
  else if(tr.ThrottlePosition==1 && bp.IntakeManifoldPressure<13)
  {
   write("Boost Building");
  }
  else if(tr.ThrottlePosition==1 && bp.IntakeManifoldPressure>=14)
  {
   write("Boost Ready");
    }}
  else
  {
    lc.LaunchStatus=0;
  }
  


}

on message BoostPressure
{
  if (bp.IntakeManifoldPressure<5)
  {
    tr.IntakeValve=10;
    
  }
  else if(bp.IntakeManifoldPressure<=11)
  {
    tr.IntakeValve=45;
  }
  else if(bp.IntakeManifoldPressure>11)
  {
    tr.IntakeValve=90;
  }
output(tr);
  
}
on message ThrottleMsg
{if(sp.Speed<=327)
{if (tr.ThrottlePosition==1 && br.Brake_Status!=1)
    sp.Speed=sp.Speed+3;
}}
on message BrakeMsg
{if(sp.Speed<=8)
{sp.Speed=0;
}
else{
  if (br.Brake_Status==1)
  {
    sp.Speed=sp.Speed-8;
    
  }
}
}
on key 'a'
{
  lc.ActiveSwitch=1;
  output(lc);
  
}
on sysvar BrakeSystem::Brake
{
  br.Brake_Status=@BrakeSystem::Brake;
  output(br);
}

on sysvar Mode::Active
{
  lc.ActiveSwitch=@Mode::Active;
  output(lc);
}
on sysvar Mode::Launch
{
  lc.LauchSwitch=@Mode::Launch;
  output(lc);
}



on sysvar Throttle::Accelerator
{
  tr.ThrottlePosition=@Throttle::Accelerator;
  output(tr);
}